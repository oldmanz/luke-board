## boards/shields/zboard/Kconfig.defconfig
```kconfig
# Copyright (c) 2020 The ZMK Contributors
# SPDX-License-Identifier: MIT

if SHIELD_ZBOARD

config ZMK_KEYBOARD_NAME
    default "ZBoard"

endif
```

## boards/shields/zboard/Kconfig.shield
```kconfig
# Copyright (c) 2020 The ZMK Contributors
# SPDX-License-Identifier: MIT

config SHIELD_ZBOARD
   def_bool $(shields_list_contains,zboard)
```
